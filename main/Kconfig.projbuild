## main/Kconfig.projbuild
```kconfig
menu "Torget development diagnostics"
config TORGET_BOOT_HEALTH_FORCE_FAIL
    bool "Force pending OTA image to fail its health gate"
    default n
    help
        Development-only failure injection for the physical rollback test.
endmenu

menu "VibePulse optional network features"
config TK_VIBEPULSE_INTERACTION_RELAY
    bool "Encrypted Needs You relay (works across unrelated Wi-Fi)"
    default n
    select MBEDTLS_HKDF_C
    help
        Poll a separately deployed Cloudflare mailbox for end-to-end
        encrypted Claude/Codex Needs You views and return signed encrypted
        verdicts. This is independent of the numbers relay and remains off
        in a fresh clone. Enabling it requires the four matching macros in
        secrets.h; the build fails with recovery instructions if incomplete.
endmenu
```
